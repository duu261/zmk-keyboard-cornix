## config/west.yml
```yaml
manifest:
  remotes:
    - name: zmkfirmware
      url-base: https://github.com/zmkfirmware
    - name: urob
      url-base: https://github.com/urob
    - name: hitsmaxft
      url-base: https://github.com/hitsmaxft
    - name: duu261
      url-base: https://github.com/duu261
  projects:
    - name: zmk
      remote: zmkfirmware
      revision: main
      clone-depth: 1
      import:
        file: app/west.yml
    - name: zmk-helpers
      remote: urob
      revision: main
      clone-depth: 1
    - name: zmk-rgbled-widget
      remote: hitsmaxft
      revision: main
      clone-depth: 1
    - name: snake-module
      remote: duu261
      revision: master

  self:
    path: config
```
